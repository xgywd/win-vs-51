#include <reg52.h>

//--定义使用的IO口--//
sbit PWM=P2^1;
bit DIR;

//--定义一个全局变量--// 
unsigned int count,value,timer1;

void Time1Config();

/*******************************************************************************
* 函 数 名       : main
* 函数功能		 : 主函数
* 输    入       : 无
* 输    出       : 无
*******************************************************************************/

void main(void)
{
	Time1Config();
	while(1)
	{  
		if(count>100)									
		{  
			count=0;
			if(DIR==1)					   //DIR控制增加或减小.
			/*代码应该保持良好的书写习惯,变量与常量"测试等于"时常量应该在前,
			例如:if(1==DIR),
			测试变量是否等于 0  或 1 的时候,又可以称为测试这个变量的真假.所以书写方式可以更简洁
			例如: if(DIR)  if(!DIR).这样书写不仅简洁,而且比原表达式少了一次逻辑运算.
			
			*/
			
			{
			  value++;
			}			
			if(DIR==0)
				
			{
			  value--;						//因为条件DIR==0成立,所以一开始因为这是unsigned 所以value变量一开始就减成了65535 	
			}
				
		}

		if(value==1000)							//
		{
		  DIR=0;
		}
		if(value==0)
		{
		  DIR=1;
		}	
				
		if(timer1>1000)  //PWM周期为100*1us
		{
			timer1=0;
		}
		if(timer1 <value)	
		{
			PWM=1;
		}
		else
		{
			PWM=0;
		}
	}
	

 }

/*******************************************************************************
* 函 数 名       : Time1Config
* 函数功能		 : 设置定时器
* 输    入       : 无
* 输    出       : 无
*******************************************************************************/

void Time1Config()
{
	TMOD|= 0x10;   //设置定时计数器工作方式1为定时器

	//--定时器赋初始值，12MHZ下定时1us--//  
	TH1 = 0xFF; 
	TL1 = 0xff;

	
	ET1 = 1; 	 //开启定时器1中断
	EA = 1;
	TR1 = 1;	 //开启定时器	
}

/*******************************************************************************
* 函 数 名       : Time1
* 函数功能		 : 定时器1的中断函数
* 输    入       : 无
* 输    出       : 无
*******************************************************************************/

void Time1(void) interrupt 3    //3 为定时器1的中断号  1 定时器0的中断号 0 外部中断1 2 外部中断2  4 串口中断
{
	TH1 = 0xFF;  //重新赋初值
	TL1 = 0xFf;
	timer1++; 
    count++;
	
}

























