/******************************头文件加载与宏定义**************************************************/
#include <reg52.h>                 
																		/*用于声明特殊功能寄存器的名称.
																			如果没有这个头文件，特殊功能寄存器，只能用硬件的地址进行读写操作。*/

typedef  unsigned int uint;
typedef  unsigned char uchar;
/******************************声明全局函数和变量*********************************************************/
/*此处增加其它全局声明*/

void init();	//1602初始化函数

void wcom(uchar com);
void wdat(uchar dat);

void delay(uint i);

uchar pulse_dly=0;
sbit rs=P1^0;
sbit rw=P1^1;
sbit e=P1^2;
uchar table1[]="       good     ";
uchar table2[]="     morning    ";

/**************************************主函数*************************************************/
void main()
{
	
	/*C51所有变量声明必须在代码段前*/
	uchar i;
	
	/*此处增加其它局部声明*/
	
	
	
/************************************定时器初始化***************************************************/
	
	TMOD=0x01;		/*0000 0001   TMOD 是计时器工作方式寄存器,有8位
	
									高四位设置定时器1.低四位定时器0. 两者设置相同.
									
									低四位0001 
									低两位01 代表方式1:16位寄存器
									{00	代表方式0:13位寄存器(高8,低5).
									10	代表方式3:8位自动重装定时:高8位溢出后,	
									低8位数值自动装入高8位做为初值.
									11	代表方式4:分为两个单独的8位定时/计数器}. 
									最高位0代表:GATE位(0不受中断控制,1受中断控制),
									第二位代表:CT位(选择0为定时器,选择1为计数器)*/
	/*********************************定时器加载初值******************************************************/
	
	TH0=(65536-500)/256;	/*定时器0是由两个8位寄存器TH0与TL0组成,
							  定时器初值计算方法为65536减去定时间隔除以256放入高8位,*/
	TL0=(65536-500)%256;	/*再用65536减去定时间隔取余256放入低8位*/
/**********************************开中断****************************************************/
	
	EA=1;	//开总中断
	ET0=1; //开定时器0中断
	TR0=1;	//启动定时器0 

/***************************************************************************************/	
	
	init();
	wcom(0x80);
	for (i=0;i<16;i++)
	{
		wdat(table1[i]);
		delay(1);
	
	}
	wcom(0x80+0x40);
	for (i=0;i<16;i++)
	{
		
		wdat(table2[i]);
		delay(1);
	}
	while(1);
	
}
void init ()
{
	delay(30);
	wcom(0x38);
	delay(10);
	wcom(0x38);
	delay(10);
	wcom(0x38);
	wcom(0x38);
	wcom(0x08);
	wcom(0x01);
	wcom(0x06);
	wcom(0x0c);
}
void wcom(uchar com)
{
	e=0;
	rs=0;
	rw=0;
	P0=com;
	delay(1);
	e=1;
	delay(2);
	e=0;
}
void wdat(uchar dat)
{
	e=0;
	rs=1;
	rw=0;
	P0=dat;
	delay(1);
	e=1;
	delay(2);
	e=0;	
}


void delaytime() interrupt 1
{
	TH0=(65536-1000)/256;
	
	TL0=(65536-1000)%256;
	
	pulse_dly++;
}


void delay(uint i)
{
	pulse_dly=0;
	while(i!=pulse_dly);
}